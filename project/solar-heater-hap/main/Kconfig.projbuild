## project/solar-heater-hap/main/Kconfig.projbuild
```kconfig
menu "Device Settings"

    menu "GPIO pins"

        config SH_PIN_T_COL
            int "DS18B20 collector (1-Wire)"
            default 1
        config SH_PIN_T_TANK
            int "DS18B20 tank (1-Wire)"
            default 2
        config SH_PIN_RELAY
            int "Pump relay (active high, transistor driver)"
            default 4
        config SH_PIN_TM1637_CLK
            int "TM1637 CLK"
            default 5
        config SH_PIN_TM1637_DIO
            int "TM1637 DIO"
            default 6
        config SH_PIN_BTN_MENU
            int "Button 1 (menu)"
            default 7
        config SH_PIN_BTN_MINUS
            int "Button 2 (-)"
            default 8
        config SH_PIN_BTN_PLUS
            int "Button 3 (+)"
            default 9
        config SH_PIN_LED
            int "Onboard WS2812 RGB LED"
            default 21

    endmenu

    menu "Control"

        config SH_MEASURE_PERIOD_S
            int "Temperature measurement period (s)"
            range 5 60
            default 10
            help
                Both sensors are measured this often, in their own task, independently of the
                1 s control loop. No averaging.

        config SH_DIFF_ON_K
            int "Switch-on difference, collector - tank (K)"
            range 3 20
            default 6
            help
                Default of the menu value d.on (stored in NVS): the pump starts when the
                collector is at least this much warmer than the tank.

        config SH_DIFF_OFF_K
            int "Switch-off difference, collector - tank (K)"
            range 1 15
            default 4
            help
                Default of the menu value d.oF (stored in NVS): the pump stops when the
                difference falls to this value (after the minimum run time). Must be lower than
                the switch-on difference (checked at compile time).

        config SH_MIN_RUN_MIN
            int "Minimum run time (min)"
            range 1 10
            default 3
            help
                The difference can stop the pump only after it has run this long. The
                protections ignore it.

        config SH_MIN_OFF_MIN
            int "Minimum off time (min)"
            range 0 10
            default 2
            help
                The difference can start the pump only after it has been off this long
                (0 = no minimum). The collector protection ignores it.

        config SH_TANK_MAX_C
            int "Tank Tmax (degC)"
            range 30 85
            default 70
            help
                Default of the menu value tbo (stored in NVS). Normal charging stops at this tank
                temperature and is allowed again below Tmax - 2 K. The collector protection may
                charge above it, up to the fixed 95 degC emergency ceiling.

        config SH_COL_MIN_C
            int "Minimum collector temperature (degC)"
            range 10 80
            default 25
            help
                Default of the menu value C.Lo (stored in NVS): the difference does not start
                the pump while the collector is below this temperature. A running pump is not
                stopped by it.

        config SH_COL_MIN_WINTER_C
            int "Winter: minimum collector temperature (degC)"
            range 10 80
            default 15
            help
                Defaults of the winter set of the seasonal values (C.Lo, d.on, d.oF; stored in
                NVS). The values above are the summer set. The menu shows the set of the current
                season, the web interface both.

        config SH_DIFF_ON_WINTER_K
            int "Winter: switch-on difference (K)"
            range 3 20
            default 5

        config SH_DIFF_OFF_WINTER_K
            int "Winter: switch-off difference (K)"
            range 1 15
            default 3
            help
                Must be lower than the winter switch-on difference (checked at compile time).

        config SH_COL_PROTECT_C
            int "Collector protection (degC)"
            range 70 160
            default 110
            help
                The pump starts at once at this collector temperature, also above Tmax, and
                stops below it - 2 K after the minimum run time. It is limited to
                min(collector maximum - 5 K, boiling point - 10 K), computed from the installer
                data; the limit is logged and shown in the web interface ("Service").

        config SH_FROST_PROTECT
            bool "Frost protection"
            default y
            help
                Default of the web interface switch (stored in NVS). While the collector is below
                the frost threshold (computed from the heat transfer fluid) and the tank is at
                least 5 degC, the pump runs; it stops at the threshold + 2 K after the minimum
                run time.

        config SH_PUMP_TEST_S
            int "Pump test time (s)"
            range 60 900
            default 300
            help
                Default of the menu value tSt (stored in NVS): how long the pump test started
                with "+" runs. A multiple of 30 s (the menu step; checked at compile time).

        config SH_E6_TIME_MIN
            int "E6 pump failure: skipped run time and window (min)"
            range 5 30
            default 10
            help
                E6 (pump failure / no flow, doc/led-indication.md 6) is checked only while the
                pump runs continuously by the normal control. The first this many minutes of the
                run are skipped (cold liquid from the pipes cools the collector, then it comes
                back quickly); then, once a minute, the rises over the last this many minutes are
                compared. The first check is after twice this time.

        config SH_E6_COL_RISE_K
            int "E6: collector rise over the window (K)"
            range 3 30
            default 10
            help
                E6 is declared when the collector rose at least this much over the window ...

        config SH_E6_TANK_RISE_DK
            int "E6: tank rise over the window (0.1 K)"
            range 1 30
            default 5
            help
                ... the tank rose less than this (tenths of K, 5 = 0.5 K) ...; E6 is cleared when
                the tank rose at least this much.

        config SH_E6_DIFF_K
            int "E6: collector - tank difference (K)"
            range 10 50
            default 20
            help
                ... and the difference collector - tank is at least this much.

        config SH_E6_CLEAR_DIFF_K
            int "E6 cleared: collector - tank difference below (K)"
            range 3 30
            default 10
            help
                E6 is cleared when the difference falls below this (there is flow). Must be lower
                than the E6 difference (checked at compile time). Otherwise E6 stays until restart.

    endmenu

    menu "Installer data"

        config SH_INST_GLYCOL
            bool "Heat transfer fluid: propylene glycol (off: water)"
            default n
            help
                Defaults of the installer data (stored in NVS, changed in the "Service" section
                of the web interface). The boiling point, the ceiling of the collector protection
                and the frost threshold are computed from them.

        config SH_INST_GLYCOL_PCT
            int "Propylene glycol (% by volume)"
            depends on SH_INST_GLYCOL
            range 0 60
            default 0

        config SH_INST_PRESSURE_DBAR
            int "Minimum pressure on the gauge, cold system (0.1 bar)"
            range 5 60
            default 15
            help
                Tenths of bar: 15 = 1.5 bar. The firmware adds 1.013 bar for the absolute
                pressure.

        config SH_INST_COL_MAX_C
            int "Maximum collector temperature (degC)"
            range 100 250
            default 120
            help
                What the collector withstands (manufacturer data). The collector protection is
                kept at least 5 K below it.

        config SH_INST_COL_TUBES
            bool "Collector: evacuated tubes (off: flat)"
            default n
            help
                With the area and the tank volume: the target of the night cooling (how much a
                clear summer day can heat the tank: flat 2.5 kWh/m2, tubes 3.0 kWh/m2).

        config SH_INST_COL_AREA_DM2
            int "Collector area (0.1 m2)"
            range 5 200
            default 20
            help
                Tenths of a square metre: 20 = 2.0 m2.

        config SH_INST_TANK_L
            int "Tank volume (l)"
            range 50 1000
            default 150
            help
                A multiple of 10 l (checked at compile time).

        config SH_INST_HEATER_DKW
            int "Heater in the tank (0.1 kW, 0 = none)"
            range 0 120
            default 20
            help
                Tenths of a kilowatt: 20 = 2.0 kW; 0 = no heater, otherwise 5 - 120 (0.5 - 12.0 kW)
                in steps of 0.5 kW (a multiple of 5, checked at compile time). The rise that
                counts as a working heater and the leak checks of the heater depend on it.

        config SH_INST_MOUNT_PIPES
            bool "Sensors on the pipes: pulse mode (off: in the sleeves)"
            default n
            help
                The sensors on the pipes outside the collector and the tank (metal pipes only):
                the pump runs in pulses of 30 s and the decisions take the values measured 30 s
                after the pump started (doc/operating-modes.md 2.1, p. 16).

    endmenu

    menu "HomeKit"

        config SH_HAP_FIXED_SETUP_CODE
            bool "Fixed setup code (development only)"
            default n
            help
                A product reads its own setup info (salt / verifier of a unique setup code, setup
                ID) from the factory_nvs partition, prepared by the owner with the label (as in
                mppt-1k). For the development only, a fixed code from here, so that no setup
                payload must be written after each erase of the flash. Never in a product.

        config SH_HAP_SETUP_CODE
            string "Setup code (xxx-xx-xxx)"
            default "111-22-333"
            depends on SH_HAP_FIXED_SETUP_CODE

        config SH_HAP_SETUP_ID
            string "Setup ID (4 characters)"
            default "SH14"
            depends on SH_HAP_FIXED_SETUP_CODE

    endmenu

    config SH_INTERNAL_PULLUPS
        bool "Internal pull-ups on the 1-Wire and TM1637 lines (development prototype)"
        default y
        select ONEWIRE_INTERNAL_PULLUP
        help
            On the development prototype the external pull-up resistors are not fitted yet,
            so the internal ones (~45 kOhm) are enabled. Turn this off once the external
            4.7 kOhm (DS18B20) and 10 kOhm (TM1637) resistors are on the board.

    config SH_NET_RESET_HOLD_S
        int "Wi-Fi reset: hold the menu button (s)"
        range 3 7
        default 5
        help
            Releasing the menu button after holding it at least this long (and less than the
            factory reset time) erases the stored Wi-Fi network and restarts the device into
            the setup portal. 3 - 7 s, so it never overlaps the factory reset (8 - 12 s).

    config SH_FACTORY_RESET_HOLD_S
        int "Factory reset: hold the menu button (s)"
        range 8 12
        default 9
        help
            Holding the menu button this long erases everything (HomeKit pairings, device
            settings and the Wi-Fi network) and restarts the device; it starts while the
            button is still held.

    config SH_LED_BRIGHTNESS
        int "Status LED brightness (%)"
        range 1 100
        default 20
        help
            20 % chosen on the hardware (25 % was already bright enough, doc/firmware.md).

    config SH_LED_COLD_C
        int "Status LED: cold collector, white below (degC)"
        range 0 40
        default 20
        help
            The LED is white (pump stopped, nothing else to show) while the collector is below
            this temperature; it returns to blue above it + 2 K.

    config SH_LED_HOT_C
        int "Status LED: hot collector, yellow above (degC)"
        range 50 120
        default 90
        help
            The LED is yellow while the pump is stopped and the collector is above this
            temperature; it returns below it - 2 K.

endmenu
```
